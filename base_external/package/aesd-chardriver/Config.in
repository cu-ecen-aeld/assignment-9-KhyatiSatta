## base_external/package/aesd-chardriver/Config.in
```kconfig
config BR2_PACKAGE_AESD_CHARDRIVER
	bool "aesd-chardriver"
	help
	  Circular buffer based driver implementation
```

## base_external/package/ldd/Config.in
```kconfig
config BR2_PACKAGE_LDD
	bool "ldd"
	help
      Includes misc modules and scull components and instructions to build them
```
